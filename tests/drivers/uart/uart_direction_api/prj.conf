## CMakeLists.txt
```
# SPDX-License-Identifier: Apache-2.0

cmake_minimum_required(VERSION 3.20.0)
find_package(Zephyr REQUIRED HINTS $ENV{ZEPHYR_BASE})
project(uart_direction_api)

target_sources(app PRIVATE
    src/main.c
    src/test_uart_direction.c
    )
```

## prj.conf
```kconfig
CONFIG_SERIAL=y
CONFIG_UART_INTERRUPT_DRIVEN=y
CONFIG_ZTEST=y
CONFIG_UART_DIRECTION=y
```

## src/main.c
```c
/*
 * Copyright (c) 2021 Baumer
 *
 * SPDX-License-Identifier: Apache-2.0
 */

/**
 * @addtogroup t_driver_uart
 * @{
 * @defgroup t_uart_direction test_uart_direction_operations
 * @}
 */

#include "test_uart.h"
void test_main(void)
{
	ztest_test_suite(uart_direction_test,
			 ztest_unit_test(test_uart_direction_rx),
			 ztest_unit_test(test_uart_direction_tx));
	ztest_run_test_suite(uart_direction_test);
}
```

## src/test_uart.h
```c
/*
 * Copyright (c) 2021 Baumer
 *
 * SPDX-License-Identifier: Apache-2.0
 */

/**
 * @file
 * @brief UART cases header file
 *
 * Header file for UART cases
 */

#ifndef __TEST_UART_H__
#define __TEST_UART_H__

#include <drivers/uart.h>
#include <ztest.h>

void test_uart_direction_rx(void);
void test_uart_direction_tx(void);

#endif /* __TEST_UART_H__ */
```

## src/test_uart_direction.c
```c
/*
 * Copyright (c) 2021 Baumer
 *
 * SPDX-License-Identifier: Apache-2.0
 */

#include "test_uart.h"

static volatile bool data_transmitted;
static volatile bool data_received;
static int char_sent;
static int char_received;

static const char *fifo_data = "This is a direction mode test.\r\n";

#define DATA_SIZE	(sizeof(fifo_data) - 1)

/* RX and TX pins have to be connected together*/
#if defined(CONFIG_BOARD_NUCLEO_G071RB)
#define UART_DEVICE DEVICE_DT_GET(DT_NODELABEL(usart1))
#else
#define UART_DEVICE DEVICE_DT_GET(DT_CHOSEN(zephyr_console))
#endif

static int tx_data_idx;

static void uart_fifo_callback(const struct device *dev, void *user_data)
{
	uint8_t recvData;


	ARG_UNUSED(user_data);

	if (!uart_irq_update(dev)) {
		TC_PRINT("retval should always be 1\n");
		return;
	}

	if (uart_irq_tx_ready(dev) && tx_data_idx < DATA_SIZE) {
		if (uart_fifo_fill(dev,
				   (uint8_t *)&fifo_data[tx_data_idx++], 1) > 0) {
			data_transmitted = true;
			char_sent++;
		}

		if (tx_data_idx == DATA_SIZE) {
			uart_irq_tx_disable(dev);
		}
	}

	if (uart_irq_rx_ready(dev)) {
		uart_fifo_read(dev, &recvData, 1);
		data_received = true;
		char_received++;
	}
}

static int test_rx(const struct device *uart_dev)
{
	data_received = false;
	char_received = 0;
	tx_data_idx = 0;

	uart_irq_rx_enable(uart_dev);
	uart_irq_tx_enable(uart_dev);

	k_sleep(K_MSEC(500));

	uart_irq_tx_disable(uart_dev);
	uart_irq_rx_disable(uart_dev);

	if (!data_received) {
		return TC_FAIL;
	}

	if (char_received == DATA_SIZE) {
		return TC_PASS;
	} else {
		return TC_FAIL;
	}
}

static int test_tx(const struct device *uart_dev)
{
	data_transmitted = false;
	char_sent = 0;
	tx_data_idx = 0;

	uart_irq_tx_enable(uart_dev);

	k_sleep(K_MSEC(500));

	uart_irq_tx_disable(uart_dev);

	if (!data_transmitted) {
		return TC_FAIL;
	}

	if (char_sent == DATA_SIZE) {
		return TC_PASS;
	} else {
		return TC_FAIL;
	}
}

static int test_direction_rx(void)
{
	const struct device *uart_dev = UART_DEVICE;

	if (!device_is_ready(uart_dev)) {
		TC_PRINT("UART device not ready\n");
		return TC_FAIL;
	}
	uart_irq_callback_set(uart_dev, uart_fifo_callback);

	uart_disable_rx_direction(uart_dev);
	zassert_true(test_rx(uart_dev) == TC_FAIL, NULL);

	uart_enable_rx_direction(uart_dev);
	zassert_true(test_rx(uart_dev) == TC_PASS, NULL);

	return TC_PASS;
}

static int test_direction_tx(void)
{
	const struct device *uart_dev = UART_DEVICE;

	if (!device_is_ready(uart_dev)) {
		TC_PRINT("UART device not ready\n");
		return TC_FAIL;
	}
	uart_irq_callback_set(uart_dev, uart_fifo_callback);

	uart_disable_tx_direction(uart_dev);
	zassert_true(test_tx(uart_dev) == TC_FAIL, NULL);

	uart_enable_tx_direction(uart_dev);
	zassert_true(test_tx(uart_dev) == TC_PASS, NULL);

	return TC_PASS;
}

void test_uart_direction_rx(void)
{
	zassert_true(test_direction_rx() == TC_PASS, NULL);
}

void test_uart_direction_tx(void)
{
	zassert_true(test_direction_tx() == TC_PASS, NULL);
}
```
